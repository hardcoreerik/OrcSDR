## apps/orcsdr-c6-bridge/sdkconfig.defaults
```kconfig
CONFIG_IDF_TARGET="esp32p4"
CONFIG_ESP32P4_SELECTS_REV_LESS_V3=y
CONFIG_ESP32P4_REV_MIN_1=y
CONFIG_ESPTOOLPY_FLASHSIZE_16MB=y
CONFIG_PARTITION_TABLE_CUSTOM=y
CONFIG_PARTITION_TABLE_CUSTOM_FILENAME="partitions.csv"
CONFIG_ESP_CONSOLE_USB_SERIAL_JTAG=y
CONFIG_ESP_CONSOLE_SECONDARY_NONE=y
CONFIG_ESP_WIFI_REMOTE_ENABLED=y
CONFIG_ESP_HOSTED_ENABLED=y
CONFIG_ESP_HOSTED_CP_TARGET_ESP32C6=y
CONFIG_ESP_HOSTED_SDIO_HOST_INTERFACE=y
CONFIG_ESP_HOSTED_SDIO_RESET_ACTIVE_HIGH=y
CONFIG_ESP_HOSTED_PRIV_SDIO_PIN_CMD_SLOT_1=13
CONFIG_ESP_HOSTED_PRIV_SDIO_PIN_CLK_SLOT_1=12
CONFIG_ESP_HOSTED_PRIV_SDIO_PIN_D0_SLOT_1=11
CONFIG_ESP_HOSTED_PRIV_SDIO_PIN_D1_4BIT_BUS_SLOT_1=10
CONFIG_ESP_HOSTED_PRIV_SDIO_PIN_D2_4BIT_BUS_SLOT_1=9
CONFIG_ESP_HOSTED_PRIV_SDIO_PIN_D3_4BIT_BUS_SLOT_1=8
CONFIG_ESP_HOSTED_SDIO_GPIO_RESET_SLAVE=15
CONFIG_ESP_HOSTED_SDIO_TX_Q_SIZE=4
CONFIG_ESP_HOSTED_SDIO_RX_Q_SIZE=2
```

## apps/orcsdr-p4-core/main/Kconfig.projbuild
```kconfig
menu "OrcSDR receivers"

    config ORCSDR_MAX_RECEIVERS
        int "RTL-SDR receivers this build runs (1 to 4)"
        range 1 4
        default 1
        help
            One radio task per receiver; each receiver takes the next dongle attached. With 1 the firmware behaves as it
            always did (six 16 KiB USB transfers). With more than one, each receiver uses two 16 KiB internal USB DMA
            transfers (the setting the four-dongle validation used) and USB clients are split across both cores.
            The code supports up to 4, but how many this console can run at once alongside the UI, Wi-Fi and audio is
            not yet measured. Check "RTL_MEM STATUS" dma_free, "RTL_CPU" and the per-receiver drops from
            "RTL_RX STATUS" with the console running before choosing more than 1 or 2.

    config ORCSDR_ETHERNET
        bool "Wired Ethernet (RMII PHY) from the board profile"
        default n
        help
            Compiles the Ethernet driver. It starts only if the selected board profile lists Ethernet pins (the Waveshare
            ESP32-P4-ETH, -POE-ETH and Module-DEV-KIT profiles do). The pins are the documented ones; they are not verified on a
            board until a link comes up, and the PHY chip is tried as IP101 first, then the generic driver. Off by default so a
            board behaves exactly as before unless this is chosen.

endmenu
```

## apps/orcsdr-p4-display-probe/sdkconfig.defaults
```kconfig
CONFIG_IDF_TARGET="esp32p4"
CONFIG_ESP32P4_SELECTS_REV_LESS_V3=y
CONFIG_ESP32P4_REV_MIN_1=y
CONFIG_ESPTOOLPY_FLASHSIZE_16MB=y
CONFIG_ESPTOOLPY_FLASHMODE_DIO=y
CONFIG_ESPTOOLPY_FLASHFREQ_40M=y
CONFIG_PARTITION_TABLE_CUSTOM=y
CONFIG_PARTITION_TABLE_CUSTOM_FILENAME="partitions.csv"
CONFIG_SPIRAM=y
CONFIG_SPIRAM_SPEED_200M=y
CONFIG_SPIRAM_MALLOC_ALWAYSINTERNAL=8192
CONFIG_CACHE_L2_CACHE_256KB=y
CONFIG_CACHE_L2_CACHE_LINE_128B=y
CONFIG_ESP_MAIN_TASK_STACK_SIZE=10240
CONFIG_COMPILER_OPTIMIZATION_PERF=y
CONFIG_ESP_CONSOLE_UART_DEFAULT=n
CONFIG_ESP_CONSOLE_UART_CUSTOM=y
CONFIG_ESP_CONSOLE_UART_NUM=0
CONFIG_ESP_CONSOLE_UART_TX_GPIO=37
CONFIG_ESP_CONSOLE_UART_RX_GPIO=38
CONFIG_ESP_CONSOLE_UART_BAUDRATE=921600
CONFIG_ORCSDR_BOARD_LILYGO_T_DISPLAY_P4_AMOLED=y
```

## apps/orcsdr-p4-hosyond-console/main/Kconfig.projbuild
```kconfig
menu "OrcSDR receivers"

    config ORCSDR_MAX_RECEIVERS
        int "RTL-SDR receivers this build runs (1 to 4)"
        range 1 4
        default 1
        help
            One radio task per receiver; each receiver takes the next dongle attached. With 1 the firmware behaves as it
            always did (six 16 KiB USB transfers). With more than one, each receiver uses two 16 KiB internal USB DMA
            transfers (the setting the four-dongle validation used) and USB clients are split across both cores.
            The code supports up to 4, but how many this console can run at once alongside the UI, Wi-Fi and audio is
            not yet measured. Check "RTL_MEM STATUS" dma_free, "RTL_CPU" and the per-receiver drops from
            "RTL_RX STATUS" with the console running before choosing more than 1 or 2.

endmenu
```

## apps/orcsdr-tdongle-s2/sdkconfig.defaults
```kconfig
CONFIG_IDF_TARGET="esp32s2"
CONFIG_ESPTOOLPY_FLASHSIZE_4MB=y
CONFIG_SPIRAM=y
CONFIG_SPIRAM_TYPE_AUTO=y
CONFIG_ESP_DEFAULT_CPU_FREQ_MHZ_240=y
CONFIG_ESP_MAIN_TASK_STACK_SIZE=6144
CONFIG_FREERTOS_HZ=1000
CONFIG_USB_HOST_CONTROL_TRANSFER_MAX_SIZE=1024
CONFIG_ESP_CONSOLE_NONE=y
```

## apps/orcsdr-waveshare-4b/main/Kconfig.projbuild
```kconfig
menu "OrcUI isolated integration"
config ORCUI_ADAPTIVE_HOME
    bool "ADAPTIVE_ORCUI_HOME (off selects unchanged LEGACY_HOME_V3)"
    default n
endmenu
```

## components/orcsdr_board_hosyond/Kconfig
```kconfig
menu "OrcSDR board"

    choice ORCSDR_BOARD
        prompt "Board profile"
        default ORCSDR_BOARD_WAVESHARE_P4_MODULE_DEV_KIT
        help
            Which ESP32-P4 board this firmware is built for. The profile supplies pins and
            which peripherals exist. Profiles that are not bench-verified say so at boot.
            The ESP-Hosted SDIO pins and reset GPIO are set separately in sdkconfig.defaults;
            the firmware warns at boot when they disagree with the chosen profile.

    config ORCSDR_BOARD_WAVESHARE_P4_MODULE_DEV_KIT
        bool "Waveshare ESP32-P4-Module-DEV-KIT (bench-verified)"

    config ORCSDR_BOARD_WAVESHARE_P4_WIFI6_POE_ETH
        bool "Waveshare ESP32-P4-WIFI6-POE-ETH (documented only)"

    config ORCSDR_BOARD_M5STACK_TAB5
        bool "M5Stack Tab5 (documented only, no display backend yet)"

    endchoice

endmenu
```

## components/rtl_sdr_v4_esp/Kconfig
```kconfig
menu "RTL-SDRv4-ESP"

    config RTL_SDR_V4_ESP_ENABLED
        bool "Enable RTL-SDRv4-ESP driver"
        default y
        help
            USB Host client for official RTL-SDR Blog V4.

    config RTL_SDR_V4_ESP_DEFAULT_TRANSFER_BYTES
        int "Default bulk transfer size (bytes)"
        default 16384
        range 512 262144
        help
            Gate 2 multi-URB default is 16384. Tab5 may override to 32768.

    config RTL_SDR_V4_ESP_DEFAULT_TRANSFER_COUNT
        int "Default number of bulk buffers"
        default 6
        range 2 8

    config RTL_SDR_V4_ESP_LOG_VERBOSE
        bool "Verbose driver logs"
        default n

endmenu
```

## experiments/orcui/waveshare4b/sdkconfig.defaults
```kconfig
# Waveshare's own 720x720 LVGL example is the compatibility reference.
CONFIG_IDF_TARGET="esp32p4"
CONFIG_BSP_LCD_TYPE_720_720_4_INCH=y
CONFIG_COMPILER_OPTIMIZATION_PERF=y
CONFIG_SPIRAM=y
CONFIG_SPIRAM_SPEED_250M=y
CONFIG_SPIRAM_XIP_FROM_PSRAM=y
CONFIG_CACHE_L2_CACHE_256KB=y
CONFIG_FREERTOS_HZ=1000
CONFIG_ESP_MAIN_TASK_STACK_SIZE=10240
CONFIG_LV_USE_CLIB_MALLOC=y
CONFIG_LV_USE_CLIB_STRING=y
CONFIG_LV_USE_CLIB_SPRINTF=y
CONFIG_LV_OS_FREERTOS=y
CONFIG_LV_FONT_MONTSERRAT_16=y
CONFIG_LV_FONT_MONTSERRAT_20=y
CONFIG_LV_DEF_REFR_PERIOD=20
```

## orcdial/c6/sdkconfig.defaults
```kconfig
CONFIG_ESP_HOSTED=y
CONFIG_ESP_HOSTED_CP=y
CONFIG_ESP_HOSTED_CP_FOR_MCU=y
CONFIG_ESP_HOSTED_CP_RPC_V2=y
CONFIG_ESP_HOSTED_CP_FEAT_WIFI=y
CONFIG_ESP_HOSTED_CP_FEAT_PEER_DATA=y
CONFIG_ESP_WIFI_ENTERPRISE_SUPPORT=n
CONFIG_BT_ENABLED=n
CONFIG_ESPTOOLPY_FLASHSIZE_4MB=y
CONFIG_PARTITION_TABLE_CUSTOM=y
CONFIG_PARTITION_TABLE_CUSTOM_FILENAME="partitions_eh_cp_ota_4m.csv"
CONFIG_FREERTOS_HZ=1000
CONFIG_ESP_WIFI_NVS_ENABLED=y
# Wi-Fi throughput profile (Espressif ESP-Hosted performance guide, ESP32-C6 as co-processor).
CONFIG_ESP_WIFI_STATIC_RX_BUFFER_NUM=16
CONFIG_ESP_WIFI_DYNAMIC_RX_BUFFER_NUM=64
CONFIG_ESP_WIFI_DYNAMIC_TX_BUFFER_NUM=64
CONFIG_ESP_WIFI_AMPDU_TX_ENABLED=y
CONFIG_ESP_WIFI_TX_BA_WIN=32
CONFIG_ESP_WIFI_AMPDU_RX_ENABLED=y
CONFIG_ESP_WIFI_RX_BA_WIN=32
```

## tools/dmr_esp32_device_probe/esp_idf/main/Kconfig.projbuild
```kconfig
menu "DMR device probe (standalone only)"
    config DMR_PROBE_SECONDS
        int "Synthetic 48 kS/s processing run duration, seconds"
        range 5 120
        default 30
        help
            No radio or USB driver is initialized. The worker benchmarks
            only synthetic precomputed IQ via the actual D1 portable receiver.

    config DMR_PROBE_PSRAM
        bool "Allocate probe receiver, SPSC queue and IQ stimulus in PSRAM"
        default y
        help
            Prevent synthetic probe buffers from consuming the scarce DMA-
            capable internal heap. For internal-only comparison, explicitly
            disable this and verify free internal RAM before starting.

    config DMR_PROBE_FORCE_OVERLOAD
        bool "Intentionally pause probe worker for 100 ms at midpoint"
        default n
        help
            Generates measured queue drops; MUST NOT be used to claim normal
            sustained 48 kS/s acceptance.
endmenu
```
